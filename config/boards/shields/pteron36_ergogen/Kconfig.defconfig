## config/boards/shields/pteron36_ergogen/Kconfig.defconfig
```kconfig
if SHIELD_PTERON36_ERGOGEN

config ZMK_KEYBOARD_NAME
    default "Pteron36 Ergogen"

endif
```

## config/boards/shields/pteron36_ergogen/Kconfig.shield
```kconfig
config SHIELD_PTERON36_ERGOGEN
    def_bool $(shields_list_contains,pteron36_ergogen)
```
